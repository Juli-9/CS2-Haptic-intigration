#include <Arduino.h>

#include "haptic_controller.h"
#include "timer.h"



static const uint8_t logLUT[256] =
{
     0, 32, 51, 64, 74, 82, 89, 96, 101, 106, 110, 114, 118, 121, 125, 128, 130, 133,
     135, 138, 140, 142, 144, 146, 148, 150, 152, 153, 155, 156, 158, 159, 161, 162,
     163, 165, 166, 167, 168, 170, 171, 172, 173, 174, 175, 176, 177, 178, 179, 180,
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     253, 253, 253, 253, 253, 254, 254, 254, 254, 254, 254, 255, 255, 255
};

static const uint8_t sinLUT[256] = {
  128,131,134,137,140,143,146,149,152,155,158,162,165,167,170,173,
  176,179,182,185,188,190,193,196,198,201,203,206,208,211,213,215,
  218,220,222,224,226,228,230,232,234,236,237,239,240,242,243,245,
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  80,83,86,89,91,94,98,101,104,107,110,113,116,119,122,125
};

const uint8_t sawUpLUT[256] = {
    0, 1, 2, 3, 4, 5, 6, 7,
    8, 9, 10, 11, 12, 13, 14, 15,
    16, 17, 18, 19, 20, 21, 22, 23,
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    248, 249, 250, 251, 252, 253, 254, 255
};

const uint8_t sawDownLUT[256] = {
  255, 254, 253, 252, 251, 250, 249, 248,
  247, 246, 245, 244, 243, 242, 241, 240,
  239, 238, 237, 236, 235, 234, 233, 232,
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  7, 6, 5, 4, 3, 2, 1, 0
};

const uint8_t heavyShotLUT[256] = {
      255,  255,  255,  255,  255,  255,  255,  255, 255, 255, 255, 255, 255, 255, 255, 255,
    255, 255, 255, 255, 255, 255, 255, 255, 255, 255, 255, 255, 255, 255, 255, 252,
    246, 239, 233, 227, 221, 215, 209, 204, 198, 193, 188, 183, 178, 174, 169, 164,
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      1,   1,   1,   1,   1,   1,   1,   1,   1,   1,   1,   1,   1,   1,   1,   1,
};

HapticController::HapticController(uint8_t pin1, uint8_t pin2)
{
    motor1_pin = pin1;
    motor2_pin = pin2;

    pinMode(motor1_pin, OUTPUT);
    pinMode(motor2_pin, OUTPUT);

    off();

    loop_tim.start(1.0 / float(SERIAL_COM_FREQ) * 1000);
}

void HapticController::off(){
    analogWrite(motor1_pin, 0);
    analogWrite(motor2_pin, 0);
}

void HapticController::update_position(float pos)
{
    position = constrain(pos, 0.0f, 1.0f);
}

void HapticController::update_intensity(float intens){
    intensity = constrain(intens, 0.0f, 1.0f);
}

void HapticController::update_pattern(HapticController::Pattern p, int period, bool oneShot){
    pattern_idx = 0;
    pattern = p;

    pattern_period_ms = period;

    one_shot = oneShot;

    t.start(period);
}

void HapticController::process(){

    float p = t.progress();

    if (p >= 1.0f) {
        if(one_shot){
            this->off();
            return;
        }
        t.reset();
        p = 0.0f;
    }

    pattern_idx = (uint8_t)(p * 255.0f);

    float pos = position;
    float gain1 = pos;
    float gain2 = 1.0 - pos;

    uint8_t idx1 = (uint8_t)(gain1 * 255.0f);
    uint8_t idx2 = (uint8_t)(gain2 * 255.0f);

    float base1 = logLUT[idx1] / 255.0f;
    float base2 = logLUT[idx2] / 255.0f;

    float value1 = base1 * intensity * pattern_bias();
    float value2 = base2 * intensity * pattern_bias();

    uint8_t pwm1 = (uint8_t)(value1 * 255.0f);
    uint8_t pwm2 = (uint8_t)(value2 * 255.0f);

    if(loop_tim.isFinished()){

        Serial.print(pwm1);
        Serial.print(",");
        Serial.println(pwm2);

        loop_tim.reset();
    }


    // Serial.print("pos=");        
    // Serial.print(position, 6);

    // Serial.print(" base1=");
    // Serial.print(base1, 6);

    // Serial.print(" intensity=");
    // Serial.print(intensity, 6);

    // Serial.print(" bias=");
    // Serial.print(pattern_bias(), 6);

    // Serial.print(" value1=");
    // Serial.println(value1, 6);

    analogWrite(motor1_pin, pwm1);
    analogWrite(motor2_pin, pwm2);
}

float HapticController::pattern_bias(){
    switch (pattern) {
        case HapticController::Pattern::Constant: 
            return 1.0f;
        break;

        case HapticController::Pattern::SinePulse: 
            return float(sinLUT[pattern_idx]) / 255.0f;
        break;

        case HapticController::Pattern::SawUp: 
            return float(sawUpLUT[pattern_idx]) / 255.0f;
        break;

        
        case HapticController::Pattern::SawDown: 
            return float(sawDownLUT[pattern_idx]) / 255.0f;
        break;
                
        case HapticController::Pattern::HeavyShot: 
            return float(heavyShotLUT[pattern_idx]) / 255.0f;
        break;

        default:
            // Wird ausgeführt, wenn kein Case passt
            break;
    }
    return 1.0;
}